## zephyr-samples/drivers/dma/Kconfig
```kconfig
config DMA_EMUL
        bool "Emulated DMA driver [EXPERIMENTAL]"
        depends on DT_HAS_ZEPHYR_DMA_EMUL_ENABLED
        select EXPERIMENTAL
        help
          Emulated DMA Driver
```

## zephyr-samples/pcie_native_thread/Kconfig
```kconfig
source "Kconfig.zephyr"

config PCIE_PIPE_SERVER
	string "PCIe pipe server address"
	default "127.0.0.1"
```

## zephyr-tests/testcase.yaml
```yaml
tests:
  testing.ztest:
    harness: warppipe
    harness_config:
      type: ../build_memory_mock/memory_mock
    platform_allow:
      - native_sim_64
    tags: tests
```
